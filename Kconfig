## boards/arm/board_new/Kconfig.board
```kconfig
config BOARD_NEW_REF
    bool "New Reference Board"
    depends on SOC_GEN_2
    select SOC_IS_SOCKETED

if BOARD_NEW_REF
config BOARD
    default "board_new"
endif
```

## boards/arm/board_new/board_new_defconfig
```kconfig
# New Reference Board specific Kconfig Settings

CONFIG_SOC_SERIES_GEN_2=y
CONFIG_SOC_GEN_2=y
#
# Other configurations go here
#
```

## boards/arm/board_old/Kconfig.board
```kconfig
config BOARD_OLD_REF
    bool "Old Reference Board"
    depends on SOC_GEN_1
    select SOC_IS_SOCKETED

if BOARD_OLD_REF
config BOARD
    default "board_old"
endif
```

## boards/arm/board_old/board_old_defconfig
```kconfig
# Old Refenence Board specific Kconfig Settings

CONFIG_SOC_SERIES_GEN_1=y
CONFIG_SOC_GEN_1=y
#
# Other configurations go here
#
```

## soc/arm/company/Kconfig
```kconfig
config SOC_FAMILY_COMPANY
    bool

if SOC_FAMILY_COMPANY

config SOC_FAMILY
    string
    default "company"

config SOC_IS_SOCKETED
    bool
    default n

config SOC_IS_SOLDERED
    bool
    default n

endif # SOC_FAMILY_COMPANY
```

## soc/arm/company/Kconfig.defconfig
```kconfig
#
# Add the ability to source all of the Company SoCs for the Kconfig.defconfig files
#
rsource "*/Kconfig.defconfig.series"
```

## soc/arm/company/Kconfig.soc
```kconfig
#
# Parse all Company based SoCs and add their Kconfig.soc to the list
#
rsource "*/Kconfig.series"
```

## soc/arm/company/gen_1/Kconfig.defconfig.series
```kconfig
if SOC_SERIES_GEN_1

config SOC_SERIES
    default "gen_1"
    # This path is used to construct the path at:
    # https://github.com/zephyrproject-rtos/zephyr/blob/4004665fa77d223838d48b0758c90da86170b7eb/cmake/app/boilerplate.cmake#L546

config SOC
    default "gen_1_fpu" if SOC_HAS_FPU
    default "gen_1_test" if SOC_IS_SOCKETED

# Additional defines here
config NUM_IRQS
    default 240

rsource "Kconfig.defconfig.gen1_*"

endif # SOC_SERIES_GEN_1
```

## soc/arm/company/gen_1/Kconfig.series
```kconfig
config SOC_SERIES_GEN_1
    bool "Company Gen 1 SoC"
    select ARM
    select SOC_FAMILY_COMPANY
    help
      Enable support for Company's Gen 1 SoC

if SOC_SERIES_GEN_1

#
# Additional settings per stepping
#

endif # SOC_SERIES_GEN_1
```

## soc/arm/company/gen_1/Kconfig.soc
```kconfig
# SOC FAMILY DEFINES
choice
    prompt "Company Gen 1 Steppings"
    depends on SOC_SERIES_GEN_1

    config SOC_GEN_1_A0
        bool "A0 Stepping"
    config SOC_GEN_A1
        bool "A1 Stepping"
    config SOC_GEN_B0
        bool "B0 Stepping"

endchoice
```

## soc/arm/company/gen_2/Kconfig.defconfig.gen2_a0
```kconfig
if SOC_GEN_2_A0

config SOC_PART_NUMBER
    string

    default "random_serial_number"
    help
      This string holds the full part number of the SoC. It is a hidden option
      that you should not set directly. The part number selection choice defines
      the default value for this string.

endif # SOC_GEN_2_A0
```

## soc/arm/company/gen_2/Kconfig.defconfig.series
```kconfig
if SOC_SERIES_GEN_2

config SOC_SERIES
    default "gen_2"
    # This path is used to construct the path at:
    # https://github.com/zephyrproject-rtos/zephyr/blob/4004665fa77d223838d48b0758c90da86170b7eb/cmake/app/boilerplate.cmake#L546

config SOC
    default "gen_2_fpu" if SOC_HAS_FPU
    default "gen_2_test" if SOC_IS_SOCKETED

# Additional defines here
config NUM_IRQS
    default 240

rsource "Kconfig.defconfig.gen2_*"

endif # SOC_SERIES_GEN_2
```

## soc/arm/company/gen_2/Kconfig.series
```kconfig
config SOC_SERIES_GEN_2
    bool "Company Gen 2 SoC"
    select ARM
    select CPU_CORTEX_M4
    select SOC_FAMILY_COMPANY
    select SOC_HAS_FPU
    help
      Enable support for Company's Gen 2 SoC

if SOC_SERIES_GEN_2

#
# Additional settings per stepping
#

endif # SOC_SERIES_GEN_2
```

## soc/arm/company/gen_2/Kconfig.soc
```kconfig
# SOC FAMILY DEFINES
config SOC_GEN_2
  bool "Support for all SoCs of Gen 2"

choice
    prompt "Company Gen 2 Steppings"
    depends on SOC_SERIES_GEN_2

    config SOC_GEN_2_A0
        bool "A0 Stepping"

endchoice
```

## west.yml
```yaml
manifest:
  remotes:
    - name: github
      url-base: https://github.com
  projects:
#
# Zephyr Specific defines
#
    - name: zephyr
      remote: github
      repo-path: zephyrproject-rtos/zephyr
      import:
        name-whitelist:
          - cmsis
          - littlefs
          - mbedtls
      west-commands: scripts/west-commands.yml
      revision: v2.5.0
```
